## CMakeLists.txt
```
cmake_minimum_required(VERSION 3.5)

# Zephyr build: find_package(Zephyr) must precede project() to set up the toolchain
if(DEFINED ZEPHYR_BASE OR DEFINED ENV{ZEPHYR_BASE})
    set(CONF_FILE ${CMAKE_CURRENT_SOURCE_DIR}/zephyr/prj.conf)
    set(EXTRA_ZEPHYR_MODULES ${CMAKE_CURRENT_SOURCE_DIR})
    find_package(Zephyr REQUIRED HINTS $ENV{ZEPHYR_BASE})
    project(modem_xe310 VERSION 1.0.0)
    target_sources(app PRIVATE examples/embedded/zephyr/zephyr_main.cpp)
    target_include_directories(app PRIVATE ${CMAKE_CURRENT_SOURCE_DIR}/include ${CMAKE_CURRENT_SOURCE_DIR}/src)
    target_link_libraries(app PRIVATE modem_xe310)
    return()
endif()

project(modem_xe310 VERSION 1.0.0 LANGUAGES CXX)

set(CMAKE_CXX_STANDARD 17)
set(CMAKE_CXX_STANDARD_REQUIRED ON)

option(MODEM_BUILD_TESTS "Build unit tests" OFF)
option(MODEM_BUILD_SHARED "Build shared library" OFF)

set(MODEM_LOG_LEVEL "3" CACHE STRING "Compile-time modem log level (0=none,1=err,2=wrn,3=inf,4=dbg)")
set_property(CACHE MODEM_LOG_LEVEL PROPERTY STRINGS 0 1 2 3 4)
set(NETWORK_LOG_LEVEL "3" CACHE STRING "Compile-time network log level (0=none,1=err,2=wrn,3=inf,4=dbg)")
set_property(CACHE NETWORK_LOG_LEVEL PROPERTY STRINGS 0 1 2 3 4)

if(NOT MODEM_LOG_LEVEL MATCHES "^[0-4]$")
    message(FATAL_ERROR "MODEM_LOG_LEVEL must be 0..4")
endif()

if(NOT NETWORK_LOG_LEVEL MATCHES "^[0-4]$")
    message(FATAL_ERROR "NETWORK_LOG_LEVEL must be 0..4")
endif()

# --- Detect platform ---
if(CONFIG_ZEPHYR)
    set(MODEM_PLATFORM "zephyr")
elseif(WIN32)
    set(MODEM_PLATFORM "windows")
elseif(APPLE)
    set(MODEM_PLATFORM "macos")
elseif(UNIX)
    set(MODEM_PLATFORM "linux")
else()
    message(FATAL_ERROR "Unsupported platform")
endif()

message(STATUS "Modem xE310 — platform: ${MODEM_PLATFORM}")

# --- Core sources (platform-independent) ---
set(MODEM_CORE_SOURCES
    src/at_command.cpp
    src/modem_controller.cpp
    src/xe310.cpp
    src/network_lte.cpp
    src/i_radio_lte.cpp
)

# --- HAL sources (platform-specific) ---
if(MODEM_PLATFORM STREQUAL "zephyr")
    list(APPEND MODEM_PLATFORM_SOURCES
        src/hal/zephyr_uart.cpp
        src/hal/zephyr_timer.cpp
        src/hal/zephyr_message_queue.cpp
        src/hal/zephyr_message_channel.cpp
        src/hal/zephyr_event_flags.cpp
    )
elseif(MODEM_PLATFORM STREQUAL "windows")
    list(APPEND MODEM_PLATFORM_SOURCES
        src/hal/win32_uart.cpp
        src/hal/win32_timer.cpp
        src/hal/win32_message_queue.cpp
        src/hal/win32_message_channel.cpp
        src/hal/win32_event_flags.cpp
    )
else()
    list(APPEND MODEM_PLATFORM_SOURCES
        src/hal/posix_uart.cpp
        src/hal/posix_timer.cpp
        src/hal/posix_message_queue.cpp
        src/hal/posix_message_channel.cpp
        src/hal/posix_event_flags.cpp
    )
endif()

# --- Library target ---
if(MODEM_BUILD_SHARED)
    add_library(modem_xe310 SHARED ${MODEM_CORE_SOURCES} ${MODEM_PLATFORM_SOURCES})
else()
    add_library(modem_xe310 STATIC ${MODEM_CORE_SOURCES} ${MODEM_PLATFORM_SOURCES})
endif()

target_include_directories(modem_xe310
    PUBLIC
        $<BUILD_INTERFACE:${CMAKE_CURRENT_SOURCE_DIR}/include>
        $<INSTALL_INTERFACE:include>
)

target_compile_features(modem_xe310 PUBLIC cxx_std_17)
target_compile_definitions(modem_xe310
    PUBLIC
        MODEM_LOG_LEVEL=${MODEM_LOG_LEVEL}
        NETWORK_LOG_LEVEL=${NETWORK_LOG_LEVEL}
)

# --- Platform-specific link dependencies ---
if(MODEM_PLATFORM STREQUAL "windows")
    target_compile_definitions(modem_xe310 PRIVATE MODEM_PLATFORM_WINDOWS)
elseif(MODEM_PLATFORM STREQUAL "macos")
    target_compile_definitions(modem_xe310 PRIVATE MODEM_PLATFORM_POSIX)
    find_library(IOKIT_FRAMEWORK IOKit)
    target_link_libraries(modem_xe310 PRIVATE ${IOKIT_FRAMEWORK})
elseif(MODEM_PLATFORM STREQUAL "linux")
    target_compile_definitions(modem_xe310 PRIVATE MODEM_PLATFORM_POSIX)
elseif(MODEM_PLATFORM STREQUAL "zephyr")
    target_compile_definitions(modem_xe310 PRIVATE MODEM_PLATFORM_ZEPHYR)
endif()

# --- Install rules ---
include(GNUInstallDirs)

install(TARGETS modem_xe310
    EXPORT modem_xe310-targets
    ARCHIVE DESTINATION ${CMAKE_INSTALL_LIBDIR}
    LIBRARY DESTINATION ${CMAKE_INSTALL_LIBDIR}
    RUNTIME DESTINATION ${CMAKE_INSTALL_BINDIR}
)

install(DIRECTORY include/modem include/hal
    DESTINATION ${CMAKE_INSTALL_INCLUDEDIR}
)

install(EXPORT modem_xe310-targets
    FILE modem_xe310-config.cmake
    NAMESPACE modem::
    DESTINATION ${CMAKE_INSTALL_LIBDIR}/cmake/modem_xe310
)

# --- Application executable (desktop only) ---
if(NOT MODEM_PLATFORM STREQUAL "zephyr")
    if(MODEM_PLATFORM STREQUAL "windows")
        set(IPC_SOURCE examples/desktop/win32/win32_ipc_server.cpp)
    else()
        set(IPC_SOURCE examples/desktop/posix/posix_ipc_server.cpp)
    endif()

    add_executable(modem_app
        examples/desktop/main.cpp
        examples/desktop/app_ipc_servers.cpp
        examples/desktop/app_rpc_server.cpp
        ${IPC_SOURCE}
    )
    target_include_directories(modem_app PRIVATE ${CMAKE_CURRENT_SOURCE_DIR}/examples/desktop ${CMAKE_CURRENT_SOURCE_DIR}/src)
    target_link_libraries(modem_app PRIVATE modem_xe310)
    if(MODEM_PLATFORM STREQUAL "windows")
        target_link_libraries(modem_app PRIVATE Ws2_32)
    endif()

    if(MODEM_BUILD_TESTS)
        add_executable(test_xe310 examples/desktop/test_xe310.cpp)
        target_link_libraries(test_xe310 PRIVATE modem_xe310)
    endif()
endif()

# --- Tests (desktop only) ---
if(MODEM_BUILD_TESTS AND NOT MODEM_PLATFORM STREQUAL "zephyr")
    enable_testing()
    add_subdirectory(tests)
endif()
```

## west.yml
```
manifest:
  version: "0.13"

  remotes:
    - name: zephyrproject-rtos
      url-base: https://github.com/zephyrproject-rtos

  projects:
    - name: zephyr
      remote: zephyrproject-rtos
      revision: v4.1.0
      import:
        name-allowlist:
          - hal_nordic
          - nrfx
          - cmsis
          - mbedtls
          - picolibc
```

## prj.conf
```kconfig
CONFIG_SERIAL=y
CONFIG_UART_ASYNC_API=y
CONFIG_CPP=y
CONFIG_STD_CPP17=y
CONFIG_REQUIRES_FULL_LIBCPP=y
CONFIG_LOG=y
```

## src/main.cpp
```c
#include "modem/network_lte.h"
#include "modem/xe310.h"
#include "modem/modem_controller.h"
#include "modem/uart_factory.h"
#include "modem/message_queue_interface.h"
#include "modem/i_radio_lte.h"
#include "modem/log.h"
#include "rpc_helpers.h"
#include "modem/timer_interface.h"
#include "modem/timer_factory.h"
#include "app_ipc_servers.h"
#include "app_rpc_server.h"
#include <memory>
#include <atomic>
#include <functional>
#include <mutex>
#include <vector>

#include <thread>
#include <chrono>

MODEM_LOG_MODULE_REGISTER(modem_app);

int main(int argc, char* argv[]) { // NOLINT(bugprone-exception-escape)

    std::string port = "COM17";
    for (int i = 1; i < argc - 1; ++i) {
        if (std::string(argv[i]) == "-p") {
            port = argv[i + 1];
            break;
        }
    }

    auto uart = modem::create_platform_uart();
    modem::ModemController modem_controller(std::move(uart));

    modem_controller.connect(port.c_str(), modem::UartConfig{});

    modem::xE310 modem(modem_controller);

    modem::NetworkLteConfig lteConfig;
    std::mutex network_mutex;

    // on_data_received is a lambda so it can capture ipc and forward replies.
    auto on_data_received = [&](uint8_t cid, std::string_view data, uint16_t n_bytes) {
        MODEM_LOG_INF("Data received on CID %d (%u bytes): %.*s", cid, n_bytes, static_cast<int>(data.size()),
                      data.data());
    };

    modem::NetworkLte network(modem, lteConfig, on_data_received);
    modem::RadioLteChannels channels;
    std::atomic_bool network_worker_running{false};
    app::IpcServers ipc_servers({network, lteConfig, network_worker_running, network_mutex});
    ipc_servers.start();

    app::RpcServer rpc_server({
        network,
        lteConfig,
        channels,
        network_worker_running,
        network_mutex,
        [&]() {
            return ipc_servers.run_network_command_sync(
                [&]() { return std::string("\"") + std::string(rpc::to_str(network.state())) + "\""; });
        },
    });
    rpc_server.start();

    bool fNetRes = false;
    {
        std::scoped_lock network_lock(network_mutex);
        fNetRes = network.network_connect();
    }
    if (!fNetRes) {
        MODEM_LOG_ERR("Failed to connect to network");
        // modem_controller.disconnect();
        // return 1;
    }

    bool fRes = false;
    {
        std::scoped_lock network_lock(network_mutex);
        fRes = network.server_connect(lteConfig.conn_id, "UDP", "185.205.209.91", 10000);
    }
    if (fRes) {
        MODEM_LOG_INF("Connected to server successfully");
        // Queue initial message for TX
        std::string hello = "Hello, World!";
        std::scoped_lock network_lock(network_mutex);
        network.tx_write(lteConfig.conn_id, reinterpret_cast<const uint8_t*>(hello.data()), hello.size());
        network.call_action(modem::ModemAction::send_data);
        MODEM_LOG_INF("Initial message queued for TX");
    } else {
        MODEM_LOG_ERR("Failed to connect to server");
        // return 1;
    }

    // Event consumer thread: waits for RadioLteChannels events and logs state
    // changes, responses, and log messages published by the network thread.
    std::thread event_thread([&]() {
        constexpr uint32_t ALL_EVENTS = modem::MODEM_EVT_STATE | modem::MODEM_EVT_LOG;
        while (true) {
            uint32_t matched = channels.wait(ALL_EVENTS, true, 1000);
            if (matched == 0) continue;

            if ((matched & modem::MODEM_EVT_STATE) != 0) {
                const auto& st = channels.current_state();
                MODEM_LOG_INF("Event thread: state=%u event=%u", static_cast<unsigned>(st.state),
                              static_cast<unsigned>(st.event));
            }

            if ((matched & modem::MODEM_EVT_LOG) != 0) {
                modem::ModemLogMsg log_msg{};
                while (channels.recv_log(log_msg) == modem::MessageChannelError::ok) {
                    MODEM_LOG_INF("Event thread: log: %s", log_msg.text.c_str());
                }
            }
        }
    });

    // thread to process network events and handle IPC requests
    network_worker_running.store(true); // Set to true to indicate that the network worker thread is running
    std::thread network_thread([&]() {
        while (true) {
            {
                std::scoped_lock network_lock(network_mutex);

                // Process any pending commands from IPC servers (e.g., AT commands, network requests)
                ipc_servers.process_pending_commands();

                // Process the network state machine and handle events (e.g., attach, PDP context, data transfer)
                network.loop();

                // Process cross-thread requests via message channels
                modem::process_radio_requests(channels, network);

                // Publish current state via event flags
                //channels.publish_state(network.state(), network.event());

                // Drain RX queue and forward to IPC client
                modem::QueueMessage rx_msg;
                while (network.rx_read(lteConfig.conn_id, rx_msg) == modem::QueueError::ok) {
                    std::string payload(rx_msg.data.begin(), rx_msg.data.end());
                    MODEM_LOG_INF("RX queue [conn %d]: %s (%zu bytes)", lteConfig.conn_id, payload.c_str(),
                                  rx_msg.data.size());
                    ipc_servers.send_udp_rx(rx_msg.data.data(), static_cast<uint16_t>(rx_msg.data.size()));
                }
            }
            modem::delay_ms(10);
        }
    });

    event_thread.join();
    network_thread.join();
    return 0;
}
```

## src/app_ipc_servers.cpp
```c
#include "app_ipc_servers.h"

#include "modem/log.h"
#include "rpc_helpers.h"

#include <cstdint>
#include <future>
#include <string>
#include <vector>

MODEM_LOG_MODULE_REGISTER(app_ipc_servers);

namespace app {

IpcServers::IpcServers(IpcServersContext context)
    : context_(context),
      ipc_(9000, nullptr, IpcServer::Mode::line),
      coap_ipc_(9001, nullptr, IpcServer::Mode::framed),
      at_ipc_(9002, nullptr, IpcServer::Mode::line) {}

void IpcServers::start() {
    configure_data_ipc();
    configure_coap_ipc();
    configure_at_ipc();

    if (!ipc_.start()) {
        MODEM_LOG_WRN("IPC server failed to start on port 9000 (continuing without it)");
    } else {
        MODEM_LOG_INF("IPC server listening on localhost:9000");
    }

    if (!coap_ipc_.start()) {
        MODEM_LOG_WRN("CoAP IPC server failed to start on port 9001 (continuing without it)");
    } else {
        MODEM_LOG_INF("CoAP IPC server listening on localhost:9001 (framed binary)");
    }

    if (!at_ipc_.start()) {
        MODEM_LOG_WRN("AT IPC server failed to start on port 9002 (continuing without it)");
    } else {
        MODEM_LOG_INF("AT IPC server listening on localhost:9002 (AT command passthrough)");
    }
}

void IpcServers::send_udp_rx(const uint8_t* data, uint16_t len) {
    ipc_.send(data, len);
}

void IpcServers::enqueue_network_command(std::function<void()> command) {
    std::scoped_lock command_queue_lock(command_queue_mutex_);
    command_queue_.emplace_back(std::move(command));
}

void IpcServers::process_pending_commands() {
    std::deque<std::function<void()>> pending_commands;
    {
        std::scoped_lock command_queue_lock(command_queue_mutex_);
        pending_commands.swap(command_queue_);
    }

    for (const auto& command : pending_commands) {
        command();
    }
}

std::string IpcServers::run_network_command_sync(const std::function<std::string()>& command) {
    if (!context_.network_worker_running.load()) {
        std::scoped_lock network_lock(context_.network_mutex);
        return command();
    }

    auto done = std::make_shared<std::promise<std::string>>();
    auto result = done->get_future();
    enqueue_network_command([command, done]() mutable { done->set_value(command()); });
    return result.get();
}

std::pair<bool, std::string> IpcServers::send_at_command_sync(const std::string& cmd, uint32_t timeout_ms) {
    struct AtCommandResult {
        bool ok = false;
        std::string response;
    };

    auto run_command = [&]() {
        modem::FixedString<modem::AT_RESPONSE_MAX> response;
        MODEM_LOG_INF("AT IPC >> %s", cmd.c_str());

        AtCommandResult result{};
        result.ok = context_.network.send_at_command(cmd, response, timeout_ms);
        if (result.ok) {
            if (!response.empty()) response.append("\r\n");
            response.append("OK\r\n");
            MODEM_LOG_INF("AT IPC << %s", response.c_str());
        }
        result.response = response.c_str();
        return result;
    };

    if (!context_.network_worker_running.load()) {
        std::scoped_lock network_lock(context_.network_mutex);
        AtCommandResult result = run_command();
        return {result.ok, result.response};
    }

    auto done = std::make_shared<std::promise<AtCommandResult>>();
    auto result = done->get_future();
    enqueue_network_command([run_command, done]() mutable { done->set_value(run_command()); });

    AtCommandResult command_result = result.get();
    return {command_result.ok, command_result.response};
}

void IpcServers::configure_data_ipc() {
    ipc_.set_callback([this](const uint8_t* data, uint16_t len) {
        std::vector<uint8_t> payload(data, data + len);
        enqueue_network_command([this, payload = std::move(payload), len]() {
            if (context_.network.state() != modem::NetworkLteState::data_ready) {
                const std::string error =
                    std::string("ERROR: network not ready, state=") + rpc::to_str(context_.network.state());
                MODEM_LOG_WRN("IPC: %s", error.c_str());
                ipc_.send(reinterpret_cast<const uint8_t*>(error.data()), static_cast<uint16_t>(error.size()));
                return;
            }

            modem::QueueError queue_err = context_.network.tx_write(context_.lte_config.conn_id, payload.data(), len);
            if (queue_err != modem::QueueError::ok) {
                const std::string error =
                    std::string("ERROR: tx_write failed, code=") + std::to_string(static_cast<int>(queue_err));
                MODEM_LOG_ERR("IPC: %s", error.c_str());
                ipc_.send(reinterpret_cast<const uint8_t*>(error.data()), static_cast<uint16_t>(error.size()));
                return;
            }

            context_.network.call_action(modem::ModemAction::send_data);
            MODEM_LOG_INF("IPC: queued %u bytes for TX on conn %d", len, context_.lte_config.conn_id);
        });
        return 0;
    });
}

void IpcServers::configure_coap_ipc() {
    coap_ipc_.set_callback([this](const uint8_t* data, uint16_t len) {
        std::vector<uint8_t> payload(data, data + len);
        enqueue_network_command([this, payload = std::move(payload), len]() {
            if (context_.network.state() != modem::NetworkLteState::data_ready) {
                const std::string error =
                    std::string("ERROR: network not ready, state=") + rpc::to_str(context_.network.state());
                MODEM_LOG_WRN("CoAP IPC: %s", error.c_str());
                coap_ipc_.send(reinterpret_cast<const uint8_t*>(error.data()), static_cast<uint16_t>(error.size()));
                return;
            }

            modem::QueueError queue_err = context_.network.tx_write(context_.lte_config.conn_id, payload.data(), len);
            if (queue_err != modem::QueueError::ok) {
                const std::string error =
                    std::string("ERROR: tx_write failed, code=") + std::to_string(static_cast<int>(queue_err));
                MODEM_LOG_ERR("CoAP IPC: %s", error.c_str());
                coap_ipc_.send(reinterpret_cast<const uint8_t*>(error.data()), static_cast<uint16_t>(error.size()));
                return;
            }

            context_.network.call_action(modem::ModemAction::send_data);
            MODEM_LOG_INF("CoAP IPC: queued %u bytes for TX on conn %d", len, context_.lte_config.conn_id);
        });
    });
}

void IpcServers::configure_at_ipc() {
    at_ipc_.set_connect_callback([this]() {
        enqueue_network_command([this]() {
            MODEM_LOG_INF("AT IPC: client connected, entering transparent mode");
            context_.network.enter_transparent_mode();
        });
    });

    at_ipc_.set_callback([this](const uint8_t* data, uint16_t len) {
        std::string cmd(reinterpret_cast<const char*>(data), len);
        auto [ok, response] = send_at_command_sync(cmd, static_cast<uint32_t>(210000));
        if (!ok) {
            MODEM_LOG_ERR("AT IPC: command failed");
        }

        at_ipc_.send(reinterpret_cast<const uint8_t*>(response.data()), static_cast<uint16_t>(response.size()));
    });

    at_ipc_.set_disconnect_callback([this]() {
        enqueue_network_command([this]() {
            MODEM_LOG_INF("AT IPC: client disconnected, leaving transparent mode");
            context_.network.leave_transparent_mode();
        });
    });
}

} // namespace app
```

## src/app_ipc_servers.h
```c
#pragma once

#include "ipc_server.h"
#include "modem/network_lte.h"

#include <atomic>
#include <cstdint>
#include <deque>
#include <functional>
#include <mutex>
#include <string>
#include <utility>

namespace app {

struct IpcServersContext {
    modem::NetworkLte& network;
    modem::NetworkLteConfig& lte_config;
    std::atomic_bool& network_worker_running;
    std::mutex& network_mutex;
};

class IpcServers {
public:
    explicit IpcServers(IpcServersContext context);

    void start();
    void send_udp_rx(const uint8_t* data, uint16_t len);
    void enqueue_network_command(std::function<void()> command);
    void process_pending_commands();
    std::string run_network_command_sync(const std::function<std::string()>& command);
    std::pair<bool, std::string> send_at_command_sync(const std::string& cmd, uint32_t timeout_ms);

private:
    void configure_data_ipc();
    void configure_coap_ipc();
    void configure_at_ipc();

    IpcServersContext context_;
    IpcServer ipc_;
    IpcServer coap_ipc_;
    IpcServer at_ipc_;
    std::mutex command_queue_mutex_;
    std::deque<std::function<void()>> command_queue_;
};

} // namespace app
```

## src/app_rpc_server.cpp
```c
#include "app_rpc_server.h"

#include "modem/log.h"
#include "rpc_helpers.h"

#include <algorithm>
#include <cctype>
#include <string_view>

MODEM_LOG_MODULE_REGISTER(app_rpc_server);

namespace app {

namespace {

constexpr uint32_t RPC_TIMEOUT_DEFAULT_MS = 5000U;
constexpr uint32_t RPC_TIMEOUT_CONNECT_MS = 210000U;
constexpr uint32_t RPC_TIMEOUT_DISCONNECT_MS = 60000U;
constexpr uint32_t RPC_TIMEOUT_FORCE_PSM_MS = 30000U;

std::string to_upper(std::string value) {
    std::transform(value.begin(), value.end(), value.begin(),
                   [](unsigned char c) { return static_cast<char>(std::toupper(c)); });
    return value;
}

std::string normalize_token(std::string_view token) {
    std::string out;
    out.reserve(token.size());
    for (char c : token) {
        if (c == '_' || c == '-') continue;
        out.push_back(static_cast<char>(std::toupper(static_cast<unsigned char>(c))));
    }
    return out;
}

std::string config_key_from_resource(std::string_view resource) {
    const std::string key = normalize_token(resource);
    if (key == "CID") return "cid";
    if (key == "ATTACHTIMEOUTSEC") return "attach_timeout_sec";
    if (key == "PDPTIMEOUTSEC") return "pdp_timeout_sec";
    if (key == "DATAREADYTIMEOUTSEC") return "data_ready_timeout_sec";
    if (key == "TRANSPARENTTIMEOUTSEC") return "transparent_timeout_sec";
    if (key == "MAXNETWORKATTEMPTS") return "max_network_attempts";
    if (key == "MAXATTACHRETRIES") return "max_attach_retries";
    if (key == "MAXPDPRETRIES") return "max_pdp_retries";
    if (key == "DEFAULTLTEBANDS") return "default_lte_bands";
    if (key == "DEFAULTIOTTECH") return "default_iot_tech";
    if (key == "DEFAULTAPN") return "default_apn";
    if (key == "FALLBACKLTEBANDS") return "fallback_lte_bands";
    if (key == "FALLBACKIOTTECH") return "fallback_iot_tech";
    if (key == "FALLBACKAPN") return "fallback_apn";
    if (key == "PLMN") return "plmn";
    if (key == "FPSMENABLE" || key == "PSMENABLE") return "fPsmEnable";
    if (key == "FCFUNSLEEP" || key == "CFUNSLEEP") return "fCfunSleep";
    if (key == "PSMT3412") return "psm_t3412";
    if (key == "PSMT3324") return "psm_t3324";
    if (key == "CONNID") return "conn_id";
    return "";
}

} // namespace

RpcServer::RpcServer(RpcServerContext context)
    : context_(std::move(context)), rpc_ipc_(9003, nullptr, IpcServer::Mode::line) {}

void RpcServer::start() {
    rpc_ipc_.set_callback([this](const uint8_t* data, uint16_t len) {
        std::string request(reinterpret_cast<const char*>(data), len);
        MODEM_LOG_INF("RPC IPC >> %s", request.c_str());
        std::string response = handle_request(request) + "\r\n";
        rpc_ipc_.send(reinterpret_cast<const uint8_t*>(response.data()), static_cast<uint16_t>(response.size()));
    });

    if (!rpc_ipc_.start()) {
        MODEM_LOG_WRN("RPC IPC server failed to start on port 9003 (continuing without it)");
    } else {
        MODEM_LOG_INF("RPC IPC server listening on localhost:9003 (RPC get/set)");
    }
}

std::pair<bool, std::string> RpcServer::request_radio_state(modem::RadioLteRequestMsg msg, uint32_t timeout_ms) {
    return request_radio_state_impl(msg, timeout_ms);
}

std::pair<bool, std::string> RpcServer::request_csurv_result(uint32_t timeout_ms) {
    modem::RadioLteRequestMsg msg{modem::RadioLteRequestType::get_csurv_result, 0U, 0U};
    modem::MessageChannelError send_err = context_.channels.send_request(msg, timeout_ms);
    if (send_err != modem::MessageChannelError::ok) {
        return {false, "ERROR: failed to send request"};
    }

    uint32_t matched = context_.channels.wait(modem::MODEM_EVT_RESPONSE, true, timeout_ms);
    if ((matched & modem::MODEM_EVT_RESPONSE) == 0U) {
        return {false, "ERROR: timeout waiting response"};
    }

    modem::ModemTypedResponseMsg<modem::CsurvResult> resp{};
    if (context_.channels.recv_typed_response(resp, 0) != modem::MessageChannelError::ok) {
        return {false, "ERROR: invalid csurv_result response"};
    }
    return {resp.ok, rpc::to_json(resp.value)};
}

std::pair<bool, std::string> RpcServer::request_radio_state_impl(modem::RadioLteRequestMsg msg, uint32_t timeout_ms) {
    if (!context_.network_worker_running.load()) {
        std::scoped_lock network_lock(context_.network_mutex);
        return {false, "ERROR: network worker not running"};
    }

    modem::MessageChannelError send_err = context_.channels.send_request(msg, timeout_ms);
    if (send_err != modem::MessageChannelError::ok) {
        return {false, "ERROR: failed to send request"};
    }

    uint32_t matched = context_.channels.wait(modem::MODEM_EVT_RESPONSE, true, timeout_ms);
    if ((matched & modem::MODEM_EVT_RESPONSE) == 0U) {
        return {false, "ERROR: timeout waiting response"};
    }

    switch (msg.type) {
        case modem::RadioLteRequestType::get_registration_info: {
            modem::ModemTypedResponseMsg<modem::RegistrationInfo> resp{};
            if (context_.channels.recv_typed_response(resp, 0) != modem::MessageChannelError::ok) {
                return {false, "ERROR: invalid registration_info response"};
            }
            return {resp.ok, rpc::to_json(resp.value)};
        }
        case modem::RadioLteRequestType::get_signal_quality: {
            modem::ModemTypedResponseMsg<modem::SignalQuality> resp{};
            if (context_.channels.recv_typed_response(resp, 0) != modem::MessageChannelError::ok) {
                return {false, "ERROR: invalid signal_quality response"};
            }
            return {resp.ok, rpc::to_json(resp.value)};
        }
        case modem::RadioLteRequestType::get_iccid: {
            modem::ModemTypedResponseMsg<modem::FixedString<modem::MODEM_SHORT_STR>> resp{};
            if (context_.channels.recv_typed_response(resp, 0) != modem::MessageChannelError::ok) {
                return {false, "ERROR: invalid iccid response"};
            }
            return {resp.ok, "\"" + std::string(resp.value.c_str()) + "\""};
        }
        case modem::RadioLteRequestType::get_imsi: {
            modem::ModemTypedResponseMsg<modem::FixedString<modem::MODEM_SHORT_STR>> resp{};
            if (context_.channels.recv_typed_response(resp, 0) != modem::MessageChannelError::ok) {
                return {false, "ERROR: invalid imsi response"};
            }
            return {resp.ok, "\"" + std::string(resp.value.c_str()) + "\""};
        }
        case modem::RadioLteRequestType::get_modem_info: {
            modem::ModemTypedResponseMsg<modem::ModemInfo> resp{};
            if (context_.channels.recv_typed_response(resp, 0) != modem::MessageChannelError::ok) {
                return {false, "ERROR: invalid modem_info response"};
            }
            return {resp.ok, rpc::to_json(resp.value)};
        }
        case modem::RadioLteRequestType::get_sim_status: {
            modem::ModemTypedResponseMsg<modem::SimStatus> resp{};
            if (context_.channels.recv_typed_response(resp, 0) != modem::MessageChannelError::ok) {
                return {false, "ERROR: invalid sim_status response"};
            }
            return {resp.ok, "\"" + std::string(rpc::to_str(resp.value)) + "\""};
        }
        case modem::RadioLteRequestType::get_radio_tech: {
            modem::ModemTypedResponseMsg<modem::RadioTech> resp{};
            if (context_.channels.recv_typed_response(resp, 0) != modem::MessageChannelError::ok) {
                return {false, "ERROR: invalid radio_tech response"};
            }
            return {resp.ok, "\"" + std::string(rpc::to_str(resp.value)) + "\""};
        }
        case modem::RadioLteRequestType::get_reg_status: {
            modem::ModemTypedResponseMsg<modem::RegStatus> resp{};
            if (context_.channels.recv_typed_response(resp, 0) != modem::MessageChannelError::ok) {
                return {false, "ERROR: invalid reg_status response"};
            }
            return {resp.ok, "\"" + std::string(rpc::to_str(resp.value)) + "\""};
        }
        case modem::RadioLteRequestType::get_network_info: {
            modem::ModemTypedResponseMsg<modem::NetworkInfo> resp{};
            if (context_.channels.recv_typed_response(resp, 0) != modem::MessageChannelError::ok) {
                return {false, "ERROR: invalid network_info response"};
            }
            return {resp.ok, rpc::to_json(resp.value)};
        }
        case modem::RadioLteRequestType::get_psm_mode: {
            modem::ModemTypedResponseMsg<modem::PsmMode> resp{};
            if (context_.channels.recv_typed_response(resp, 0) != modem::MessageChannelError::ok) {
                return {false, "ERROR: invalid psm_mode response"};
            }
            return {resp.ok, "\"" + std::string(rpc::to_str(resp.value)) + "\""};
        }
        case modem::RadioLteRequestType::get_cpsms_config: {
            modem::ModemTypedResponseMsg<modem::CpsmsConfig> resp{};
            if (context_.channels.recv_typed_response(resp, 0) != modem::MessageChannelError::ok) {
                return {false, "ERROR: invalid cpsms_config response"};
            }
            return {resp.ok, rpc::to_json(resp.value)};
        }
        case modem::RadioLteRequestType::get_telit_cpsms_config: {
            modem::ModemTypedResponseMsg<modem::TelitCpsmsConfig> resp{};
            if (context_.channels.recv_typed_response(resp, 0) != modem::MessageChannelError::ok) {
                return {false, "ERROR: invalid telit_cpsms_config response"};
            }
            return {resp.ok, rpc::to_json(resp.value)};
        }
        case modem::RadioLteRequestType::get_telit_cpsms_status: {
            modem::ModemTypedResponseMsg<modem::TelitCpsmsStatus> resp{};
            if (context_.channels.recv_typed_response(resp, 0) != modem::MessageChannelError::ok) {
                return {false, "ERROR: invalid telit_cpsms_status response"};
            }
            return {resp.ok, rpc::to_json(resp.value)};
        }
        case modem::RadioLteRequestType::get_network_survey_result: {
            modem::ModemTypedResponseMsg<modem::NetworkSurveyResult> resp{};
            if (context_.channels.recv_typed_response(resp, 0) != modem::MessageChannelError::ok) {
                return {false, "ERROR: invalid network_survey_result response"};
            }
            return {resp.ok, rpc::to_json(resp.value)};
        }
        case modem::RadioLteRequestType::get_available_operators: {
            modem::ModemTypedResponseMsg<modem::StaticVector<modem::Operator, modem::xE310::MAX_OPERATORS>> resp{};
            if (context_.channels.recv_typed_response(resp, 0) != modem::MessageChannelError::ok) {
                return {false, "ERROR: invalid available_operators response"};
            }
            return {resp.ok, rpc::to_json(resp.value)};
        }
        case modem::RadioLteRequestType::get_csurv_result: {
            modem::ModemTypedResponseMsg<modem::CsurvResult> resp{};
            if (context_.channels.recv_typed_response(resp, 0) != modem::MessageChannelError::ok) {
                return {false, "ERROR: invalid csurv_result response"};
            }
            return {resp.ok, rpc::to_json(resp.value)};
        }
        case modem::RadioLteRequestType::scan_networks: {
            modem::ModemTypedResponseMsg<bool> resp{};
            if (context_.channels.recv_typed_response(resp, 0) != modem::MessageChannelError::ok) {
                return {false, "ERROR: invalid scan_networks response"};
            }
            if (!resp.ok || !resp.value) {
                return {false, "ERROR: scan_networks failed"};
            }
            return request_csurv_result(timeout_ms);
        }
        case modem::RadioLteRequestType::get_server_info_array: {
            modem::ModemTypedResponseMsg<const modem::ServerInfo*> resp{};
            if (context_.channels.recv_typed_response(resp, 0) != modem::MessageChannelError::ok) {
                return {false, "ERROR: invalid server_info_array response"};
            }
            if (!resp.ok || resp.value == nullptr) {
                return {false, "ERROR: server_info_array unavailable"};
            }
            if (msg.arg0 >= 1 && msg.arg0 <= MAX_SERVER_CONNECTIONS) {
                return {true, rpc::to_json(resp.value[msg.arg0 - 1])};
            }
            std::string out = "[";
            for (int i = 0; i < MAX_SERVER_CONNECTIONS; ++i) {
                if (i > 0) out += ',';
                out += rpc::to_json(resp.value[i]);
            }
            out += "]";
            return {true, out};
        }
        case modem::RadioLteRequestType::get_config: {
            modem::ModemTypedResponseMsg<modem::NetworkLteConfig> resp{};
            if (context_.channels.recv_typed_response(resp, 0) != modem::MessageChannelError::ok) {
                return {false, "ERROR: invalid config response"};
            }
            return {resp.ok, rpc::config_to_json(resp.value)};
        }
        case modem::RadioLteRequestType::set_config:
        case modem::RadioLteRequestType::network_connect:
        case modem::RadioLteRequestType::network_disconnect:
        case modem::RadioLteRequestType::server_disconnect:
        case modem::RadioLteRequestType::force_psm:
        default: {
            modem::ModemTypedResponseMsg<bool> resp{};
            if (context_.channels.recv_typed_response(resp, 0) != modem::MessageChannelError::ok) {
                return {false, "ERROR: invalid response"};
            }
            return {resp.ok && resp.value, resp.value ? "true" : "false"};
        }
    }
}

std::string RpcServer::handle_request(const std::string& request) {
    auto sp = request.find(' ');
    std::string cmd = to_upper(sp == std::string::npos ? request : request.substr(0, sp));
    std::string sub_orig = sp == std::string::npos ? "" : request.substr(sp + 1);
    std::string sub = to_upper(sub_orig);

    if (cmd == "GET") {
        if (sub == "SCANSURVEY") {
            auto [ok, payload] =
                request_radio_state({modem::RadioLteRequestType::scan_networks, 0U, 0U}, static_cast<uint32_t>(210000));
            if (!ok) return payload;
            return payload;
        }
        if (sub == "CONFIG")
            return request_radio_state({modem::RadioLteRequestType::get_config, 0U, 0U}, RPC_TIMEOUT_DEFAULT_MS).second;
        if (sub == "MODEMINFO")
            return request_radio_state({modem::RadioLteRequestType::get_modem_info, 0U, 0U}, RPC_TIMEOUT_DEFAULT_MS)
                .second;
        if (sub == "SIMSTATUS")
            return request_radio_state({modem::RadioLteRequestType::get_sim_status, 0U, 0U}, RPC_TIMEOUT_DEFAULT_MS)
                .second;
        if (sub == "RADIOTECH")
            return request_radio_state({modem::RadioLteRequestType::get_radio_tech, 0U, 0U}, RPC_TIMEOUT_DEFAULT_MS)
                .second;
        if (sub == "REGSTATUS")
            return request_radio_state({modem::RadioLteRequestType::get_reg_status, 0U, 0U}, RPC_TIMEOUT_DEFAULT_MS)
                .second;
        if (sub == "REGINFO") {
            return request_radio_state({modem::RadioLteRequestType::get_registration_info, 0U, 0U},
                                       RPC_TIMEOUT_DEFAULT_MS)
                .second;
        }
        if (sub == "NETWORKINFO") {
            return request_radio_state({modem::RadioLteRequestType::get_network_info, 0U, 0U}, RPC_TIMEOUT_DEFAULT_MS)
                .second;
        }
        if (sub == "SIGNALQUALITY") {
            return request_radio_state({modem::RadioLteRequestType::get_signal_quality, 0U, 0U}, RPC_TIMEOUT_DEFAULT_MS)
                .second;
        }
        if (sub == "PSMMODE")
            return request_radio_state({modem::RadioLteRequestType::get_psm_mode, 0U, 0U}, RPC_TIMEOUT_DEFAULT_MS)
                .second;
        if (sub == "CPSMSCONFIG") {
            return request_radio_state({modem::RadioLteRequestType::get_cpsms_config, 0U, 0U}, RPC_TIMEOUT_DEFAULT_MS)
                .second;
        }
        if (sub == "TELITCPSMSCONFIG") {
            return request_radio_state({modem::RadioLteRequestType::get_telit_cpsms_config, 0U, 0U},
                                       RPC_TIMEOUT_DEFAULT_MS)
                .second;
        }
        if (sub == "TELITCPSMSSTATUS") {
            return request_radio_state({modem::RadioLteRequestType::get_telit_cpsms_status, 0U, 0U},
                                       RPC_TIMEOUT_DEFAULT_MS)
                .second;
        }
        if (sub == "SURVEYRESULT") {
            return request_radio_state({modem::RadioLteRequestType::get_network_survey_result, 0U, 0U},
                                       RPC_TIMEOUT_DEFAULT_MS)
                .second;
        }
        if (sub == "OPERATORLIST") {
            return request_radio_state({modem::RadioLteRequestType::get_available_operators, 0U, 0U},
                                       RPC_TIMEOUT_DEFAULT_MS)
                .second;
        }
        if (sub == "STATE") {
            return context_.get_network_state();
        }
        if (sub.rfind("SERVERINFO", 0) == 0) {
            std::string arg = sub.size() > 10 ? sub.substr(11) : "";
            if (!arg.empty()) {
                int n = 0;
                bool is_valid = true;
                for (char c : arg) {
                    if (c < '0' || c > '9') {
                        is_valid = false;
                        break;
                    }
                    n = (n * 10) + (c - '0');
                }
                if (!is_valid) return "ERROR: invalid conn_id";
                if (n >= 1 && n <= MAX_SERVER_CONNECTIONS) {
                    return request_radio_state(
                               {modem::RadioLteRequestType::get_server_info_array, static_cast<uint32_t>(n), 0U},
                               RPC_TIMEOUT_DEFAULT_MS)
                        .second;
                }
                return "ERROR: conn_id out of range (1-" + std::to_string(MAX_SERVER_CONNECTIONS) + ")";
            }
            return request_radio_state({modem::RadioLteRequestType::get_server_info_array, 0U, 0U},
                                       RPC_TIMEOUT_DEFAULT_MS)
                .second;
        }

        return "ERROR: unknown GET resource";
    }

    if (cmd == "SET") {
        auto sp2 = sub.find(' ');
        std::string res = sub.substr(0, sp2 == std::string::npos ? sub.size() : sp2);
        std::string args = sp2 == std::string::npos ? "" : sub_orig.substr(sp2 + 1);

        auto apply_config_update = [&](const std::string& update_expr) -> std::string {
            modem::ModemSetConfigMsg cfg_request{};
            {
                std::scoped_lock network_lock(context_.network_mutex);
                cfg_request.config = context_.network.config();
            }

            if (!rpc::apply_config_fields(update_expr, cfg_request.config)) {
                return "ERROR: no valid fields provided (use key=value pairs)";
            }

            modem::MessageChannelError send_err = context_.channels.send_request(cfg_request, 5000U);
            if (send_err != modem::MessageChannelError::ok) {
                return "ERROR: failed to send set_config request";
            }

            uint32_t matched = context_.channels.wait(modem::MODEM_EVT_RESPONSE, true, 5000U);
            if ((matched & modem::MODEM_EVT_RESPONSE) == 0U) {
                return "ERROR: timeout waiting set_config response";
            }

            modem::ModemTypedResponseMsg<bool> set_response{};
            if (context_.channels.recv_typed_response(set_response, 0) != modem::MessageChannelError::ok ||
                !set_response.ok || !set_response.value) {
                return "ERROR: no valid fields provided (use key=value pairs)";
            }

            auto [cfg_ok, cfg_payload] =
                request_radio_state({modem::RadioLteRequestType::get_config, 0U, 0U}, RPC_TIMEOUT_DEFAULT_MS);
            if (!cfg_ok) return cfg_payload;
            return cfg_payload;
        };

        if (res == "NETWORKCONNECT" || res == "CONNECT") {
            auto [ok, payload] =
                request_radio_state({modem::RadioLteRequestType::network_connect, 0U, 0U}, RPC_TIMEOUT_CONNECT_MS);
            if (!ok) return payload;
            return std::string("{") + "\"resource\":\"NETWORKCONNECT\"," + "\"network_connect\":" + payload + "}";
        }

        if (res == "NETWORKDISCONNECT" || res == "DISCONNECT") {
            int conn_id = context_.lte_config.conn_id;
            if (!args.empty()) {
                bool is_valid = true;
                conn_id = 0;
                for (char c : args) {
                    if (c < '0' || c > '9') {
                        is_valid = false;
                        break;
                    }
                    conn_id = (conn_id * 10) + (c - '0');
                }
                if (!is_valid) return "ERROR: invalid conn_id";
                if (conn_id < 1 || conn_id > MAX_SERVER_CONNECTIONS) {
                    return "ERROR: conn_id out of range (1-" + std::to_string(MAX_SERVER_CONNECTIONS) + ")";
                }
            }

            auto [server_ok, server_payload] =
                request_radio_state({modem::RadioLteRequestType::server_disconnect, static_cast<uint32_t>(conn_id), 0U},
                                    RPC_TIMEOUT_DISCONNECT_MS);
            if (!server_ok) return server_payload;

            auto [network_ok, network_payload] = request_radio_state(
                {modem::RadioLteRequestType::network_disconnect, 0U, 0U}, RPC_TIMEOUT_DISCONNECT_MS);
            if (!network_ok) return network_payload;

            return std::string("{") + "\"resource\":\"NETWORKDISCONNECT\"," + "\"conn_id\":" + std::to_string(conn_id) +
                   "," + "\"server_disconnect\":" + server_payload + "," + "\"network_disconnect\":" + network_payload +
                   "}";
        }

        if (res == "CONFIG") {
            return apply_config_update(args);
        }

        const std::string config_key = config_key_from_resource(res);
        if (!config_key.empty()) {
            if (args.empty()) {
                return "ERROR: missing value";
            }
            return apply_config_update(config_key + "=" + args);
        }

        if (res == "FORCEPSM") {
            auto [ok, payload] =
                request_radio_state({modem::RadioLteRequestType::force_psm, 0U, 0U}, RPC_TIMEOUT_FORCE_PSM_MS);
            if (!ok) return payload;
            return std::string("{") + "\"resource\":\"FORCEPSM\"," + "\"status\":" + payload + "}";
        }

        return "ERROR: unknown SET resource";
    }

    return "ERROR: unknown command - use GET <resource>, SET CONFIG <key>=<value>, or SET NETWORKDISCONNECT [conn_id]";
}

} // namespace app
```

## src/app_rpc_server.h
```c
#pragma once

#include "ipc_server.h"
#include "modem/i_radio_lte.h"
#include "modem/network_lte.h"

#include <atomic>
#include <functional>
#include <mutex>
#include <string>
#include <utility>

namespace app {

using GetNetworkStateFn = std::function<std::string()>;

struct RpcServerContext {
    modem::NetworkLte& network;
    modem::NetworkLteConfig& lte_config;
    modem::RadioLteChannels& channels;
    std::atomic_bool& network_worker_running;
    std::mutex& network_mutex;
    GetNetworkStateFn get_network_state;
};

class RpcServer {
public:
    explicit RpcServer(RpcServerContext context);

    void start();

private:
    std::string handle_request(const std::string& request);
    std::pair<bool, std::string> request_radio_state(modem::RadioLteRequestMsg msg, uint32_t timeout_ms = 5000U);
    std::pair<bool, std::string> request_radio_state_impl(modem::RadioLteRequestMsg msg, uint32_t timeout_ms);
    std::pair<bool, std::string> request_csurv_result(uint32_t timeout_ms);

    RpcServerContext context_;
    IpcServer rpc_ipc_;
};

} // namespace app
```

## src/at_command.cpp
```c
#include "modem/at_command.h"
#include "hal/log.h"

#include <algorithm>
#include <string_view>

namespace modem {

AtCommand::AtCommand(std::string_view command, uint32_t timeout_ms)
    : command_(command), timeout_ms_(timeout_ms) {}

std::string_view AtCommand::command_string() const {
    return command_.view();
}

uint32_t AtCommand::timeout_ms() const {
    return timeout_ms_;
}

AtResponse AtCommand::parse_response(std::string_view raw) {
    AtResponse response;

    if (raw.empty()) {
        response.status = AtStatus::timeout;
        return response;
    }

    MODEM_LOG_DBG("<<: %.*s", static_cast<int>(raw.size()), raw.data());

    // Split raw response into lines on AT_TERMINATOR ("\r\n")
    constexpr std::string_view TERMINATOR = AT_TERMINATOR;
    std::string_view::size_type start = 0;
    while (start < raw.size()) {
        auto end = raw.find(AT_TERMINATOR, start);
        std::string_view line = (end == std::string_view::npos) ? raw.substr(start) : raw.substr(start, end - start);
        start = (end == std::string_view::npos) ? raw.size() : end + TERMINATOR.size();

        if (line.empty()) {
            continue;
        }

        if (line == "OK") {
            response.status = AtStatus::ok;
        } else if (line == "ERROR" || line.substr(0, 11) == "+CME ERROR:" || line.substr(0, 11) == "+CMS ERROR:") {
            response.status = AtStatus::error;
        } else if (line == "BUSY") {
            response.status = AtStatus::busy;
        } else {
            if (!response.body.empty()) {
                response.body += AT_TERMINATOR;
            }
            response.body.append(line);
        }
    }

    return response;
}

} // namespace modem
```

## src/i_radio_lte_internal.h
```c
#pragma once

#include "modem/i_radio_lte.h"

namespace modem {

class NetworkLte;

/// Process pending radio LTE requests from channels and dispatch them on the network thread.
void process_radio_requests(RadioLteChannels& channels, NetworkLte& radio);

} // namespace modem
```

## src/ipc_server.h
```c
#pragma once

#include <cstdint>
#include <functional>
#include <string>

/// Lightweight TCP IPC server for desktop testing only.
/// Not part of the modem library — linked only into modem_app.
///
/// Two wire formats selectable at construction time:
///   Mode::line   — newline-delimited text (\n). Compatible with nc/telnet.
///   Mode::framed — binary [uint16_t len LE][payload]. Compatible with CoAP clients.
///
/// On Zephyr this is replaced by a dedicated thread that calls
/// network.tx_write() directly from whatever data source is available.

class IpcServer {
public:
    enum class Mode { line, framed };

    /// Called from the background thread for each complete received message.
    using MessageCallback = std::function<void(const uint8_t* data, uint16_t length)>;
    using ConnectCallback = std::function<void()>;
    using DisconnectCallback = std::function<void()>;

    explicit IpcServer(uint16_t port, MessageCallback on_message, Mode mode = Mode::line);
    ~IpcServer();

    IpcServer(const IpcServer&) = delete;
    IpcServer& operator=(const IpcServer&) = delete;

    /// Replace the message callback (must be called before start(), or while stopped).
    void set_callback(MessageCallback on_message) { on_message_ = std::move(on_message); }

    /// Called on the background thread when a client connects.
    void set_connect_callback(ConnectCallback cb) { on_connect_ = std::move(cb); }

    /// Called on the background thread when a client disconnects.
    void set_disconnect_callback(DisconnectCallback cb) { on_disconnect_ = std::move(cb); }

    /// Start the server (non-blocking — spawns a background accept thread).
    bool start();

    /// Stop the server and close all sockets.
    void stop();

    /// Send a reply to the currently connected client.
    /// Mode::line  — appends \n automatically.
    /// Mode::framed — prepends uint16_t length header.
    /// Returns false if no client is connected.
    bool send(const uint8_t* data, uint16_t length);

    bool is_running() const { return running_; }

private:
    void accept_loop();
    void client_loop(int client_fd);
    void client_loop_line(int fd);
    void client_loop_framed(int fd);

    uint16_t port_;
    Mode mode_;
    MessageCallback on_message_;
    ConnectCallback on_connect_;
    DisconnectCallback on_disconnect_;

    int server_fd_ = -1;
    int client_fd_ = -1;
    bool running_ = false;
};
```
